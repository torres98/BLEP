## CMakeLists.txt
```
# SPDX-License-Identifier: Apache-2.0

cmake_minimum_required(VERSION 3.20.0)

find_package(Zephyr REQUIRED HINTS $ENV{ZEPHYR_BASE})
project(flash_test)

target_sources(app PRIVATE src/main.cpp)
```

## prj.conf
```kconfig
CONFIG_CPLUSPLUS=y

CONFIG_NEWLIB_LIBC=y
CONFIG_LIB_CPLUSPLUS=y

#disable TrustedFirmware-M
CONFIG_BUILD_WITH_TFM=n
```

## src/main.cpp
```c
#include <iostream>

#include "flash_array.h"

int main() {
    std::cout << sizeof(unsigned int) << std::endl;

    for (int i = 0; i < 10; i++)
        std::cout << test_array[TEST_ARRAY_SIZE - i - 1] << ", ";

    std::cout << test_array[0] * test_array[1] << std::endl;
    
    return 0;
}
```
