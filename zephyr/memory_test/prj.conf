## CMakeLists.txt
```
# SPDX-License-Identifier: Apache-2.0

cmake_minimum_required(VERSION 3.20.0)

find_package(Zephyr REQUIRED HINTS $ENV{ZEPHYR_BASE})
project(utils_test)

target_sources(app PRIVATE src/main.cpp)
```

## prj.conf
```kconfig
CONFIG_CPLUSPLUS=y

#include std c/c++
CONFIG_NEWLIB_LIBC=y
CONFIG_LIB_CPLUSPLUS=y

#for exceptions
CONFIG_EXCEPTIONS=y
CONFIG_NEWLIB_LIBC_NANO=n

CONFIG_MAIN_STACK_SIZE=2048
```

## src/main.cpp
```c
#include <iostream>

struct Foo {
    uint8_t v;
};

int main() {

    std::cout << "Eccoci qua\n";
    unsigned int SIZE = 5000;

    for (unsigned int i = 0; i < 10; i++) {
        Foo* p = new Foo[SIZE];

        p[SIZE-1].v = 104;
        std::cout << p << std::endl;
        delete[] p;
    }

    std::cout << "FINE\n";
    return 0;
}
```
