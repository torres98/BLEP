## zephyr/rainbow_benchmark_c/sample.yaml
```yaml
sample:
  description: Test the given board with efficient and progressive verification of Rainbow.
  name: Rainbow Test
common:
    tags: introduction
    integration_platforms:
      - native_posix
    harness: console
    harness_config:
      type: one_line
```
