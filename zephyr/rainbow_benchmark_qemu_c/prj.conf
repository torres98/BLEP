## CMakeLists.txt
```
# SPDX-License-Identifier: Apache-2.0

cmake_minimum_required(VERSION 3.20.0)

find_package(Zephyr REQUIRED HINTS $ENV{ZEPHYR_BASE})
project(rainbow_benchmark)

if(${RAINBOW_VERSION} STREQUAL "1")
    set(GF "gf16")
elseif(${RAINBOW_VERSION} STREQUAL "2")
    set(GF "gf256")
    set(HASH_LIB "src/tiny/utils/SHA/sha384.c")
elseif(${RAINBOW_VERSION} STREQUAL "3")
    set(GF "gf256")
    set(HASH_LIB "src/tiny/utils/SHA/sha512.c")
else()
    MESSAGE(FATAL_ERROR "Rainbow version not recognized.")
endif()

add_definitions(-DRAINBOW_VERSION=${RAINBOW_VERSION})

add_definitions(-DELEM_TYPE=${GF})
add_definitions(-DELEM_ADD=${GF}_add)
add_definitions(-DELEM_SUB=${GF}_add)
add_definitions(-DELEM_MUL=${GF}_mul)

if(DEFINED ELEM_BIT_SIZE)
    add_definitions(-DELEM_BIT_SIZE=${ELEM_BIT_SIZE})
endif()

if(DEFINED GF16_LOOKUP)
    add_definitions(-DGF16_LOOKUP=${GF16_LOOKUP})
endif()

if(DEFINED GF256_LOOKUP)
    add_definitions(-DGF256_LOOKUP=${GF256_LOOKUP})
endif()

add_definitions(-DSAMPLE_SIZE=${SAMPLE_SIZE})
add_definitions(-DPROGRESSIVE_STEPS=${PROGRESSIVE_STEPS})

add_definitions(-include /home/torres/Desktop/Thesis/verification_implementation/zephyr/rainbow_test_c/src/tiny/include/${GF}.h)
#target_compile_definitions(app PRIVATE "-include /home/torres/Desktop/Thesis/verification_implementation/zephyr/rainbow_test_c/src/tiny/include/${GF}.h")

target_sources(app PRIVATE src/main.c src/tiny/schemes/rainbow.c src/tiny/utils/hash_utils.c src/tiny/utils/math_utils.c src/tiny/utils/memory_utils.c src/tiny/utils/random_utils.c src/tiny/utils/uart_utils.c src/tiny/utils/standard_verification.c src/tiny/utils/progressive_verification.c src/tiny/gf/gf_operations.c src/tiny/gf/gf16.c src/tiny/gf/${GF}.c ${HASH_LIB})
```

## prj.conf
```kconfig
#for malloc
CONFIG_NEWLIB_LIBC=y

#for sha256
CONFIG_TINYCRYPT=y
CONFIG_TINYCRYPT_SHA256=y

#for randomness
CONFIG_ENTROPY_GENERATOR=y
CONFIG_TEST_RANDOM_GENERATOR=y

#regarding memory
CONFIG_MAIN_STACK_SIZE=1536
```

## src/main.c
```c
#include <stdio.h>
#include <string.h>

#include <zephyr/kernel.h>

#include "tiny/include/math_utils.h"
#include "tiny/include/progressive_verification.h"
#include "tiny/include/standard_verification.h"
#include "tiny/include/rainbow.h"

#include "svk.h"

unsigned char salt[SALT_SIZE];
unsigned char message_digest[SHA_DIGEST_SIZE];
unsigned char final_digest[FINAL_DIGEST_SIZE];

const unsigned char message[] = "Hello, my name is Slim Shady";

int main() {
    // declare variables
    uint32_t result_vector_time = 0, eff_verification_time = 0, effprog_verification_time = 0;

    //Replace with local function
    get_message_digest(message, message_digest, strlen(message));

    // load the linear transformation and the short verification key as a Matrix objects
    MatrixDS* SVK = CreateMatrixFromArray((gf*) short_private_key, SVK_NROWS, N, false);
    MatrixDS* C = CreateMatrixFromArray((gf*) private_transformation, SVK_NROWS, n_polynomials, false);

    for (unsigned int i = 0; i < SAMPLE_SIZE; i++) {
        //Replace
        MatrixDS* s = parse_signature(salt);

        // Compute resulting vector
        get_complete_digest(final_digest, message_digest, salt);
        MatrixDS* u = get_result_vector(final_digest);

        // 1) Compute reduced resulting vector
        uint32_t starting_cycle = k_cycle_get_32();
        MatrixDS* u_eff = dot_product(C, u);
        result_vector_time += k_cyc_to_us_floor32(k_cycle_get_32() - starting_cycle);

        // 2) Perform efficient verification
        starting_cycle = k_cycle_get_32();
        verify_signature_with_result_vector(SVK, s, u_eff);
        eff_verification_time += k_cyc_to_us_floor32(k_cycle_get_32() - starting_cycle);

        // 3) Perform efficient+progressive verification
        starting_cycle = k_cycle_get_32();
        progVer_with_result_vector(SVK, s, u_eff, PROGRESSIVE_STEPS, true);
        effprog_verification_time += k_cyc_to_us_floor32(k_cycle_get_32() - starting_cycle);

        destroy_matrix(s);
        destroy_matrix(u);
        destroy_matrix(u_eff);

        //printf("%c%c\n", efficient_result, effprog_result);
    }

    printf("Average resulting vector time: %u microseconds\n", result_vector_time / SAMPLE_SIZE);
    printf("Average efficient verification time: %u microseconds\n", eff_verification_time / SAMPLE_SIZE);
    printf("Average efficient+progressive verification time: %u microseconds\n", effprog_verification_time / SAMPLE_SIZE);

    destroy_matrix(SVK);
    destroy_matrix(C);

    return 0;
}
```
