## CMakeLists.txt
```
# SPDX-License-Identifier: Apache-2.0

cmake_minimum_required(VERSION 3.20.0)

find_package(Zephyr REQUIRED HINTS $ENV{ZEPHYR_BASE})
project(rainbow_benchmark)

if(${RAINBOW_VERSION} STREQUAL "1")
    set(GF_LIB "src/tiny/gf/gf16.cpp")
elseif(${RAINBOW_VERSION} STREQUAL "2")
    set(GF_LIB "src/tiny/gf/gf256.cpp")
    set(HASH_LIB "src/tiny/utils/SHA/sha384.c")
elseif(${RAINBOW_VERSION} STREQUAL "3")
    set(GF_LIB "src/tiny/gf/gf256.cpp")
    set(HASH_LIB "src/tiny/utils/SHA/sha512.c")
else()
    MESSAGE(FATAL_ERROR "Rainbow version not recognized.")
endif()

add_definitions(-DRAINBOW_VERSION=${RAINBOW_VERSION})

if(DEFINED GF16_LOOKUP)
    add_definitions(-DGF16_LOOKUP=${GF16_LOOKUP})
endif()

if(DEFINED GF256_LOOKUP)
    add_definitions(-DGF256_LOOKUP=${GF256_LOOKUP})
endif()

add_definitions(-DSAMPLE_SIZE=${SAMPLE_SIZE})
add_definitions(-DPROGRESSIVE_STEPS=${PROGRESSIVE_STEPS})

target_sources(app PRIVATE src/main.cpp src/tiny/schemes/rainbow.cpp src/tiny/utils/uart_utils.cpp src/tiny/utils/hash_utils.cpp ${GF_LIB} ${HASH_LIB})
```

## sample.yaml
```
sample:
  description: Benchmark the given board with efficient and progressive verification of Rainbow.
  name: Rainbow Benchmark
common:
    tags: introduction
    integration_platforms:
      - native_posix
    harness: console
    harness_config:
      type: one_line
```

## prj.conf
```kconfig
CONFIG_CPLUSPLUS=y
CONFIG_STD_CPP17=y

#include std c/c++
CONFIG_NEWLIB_LIBC=y
CONFIG_LIB_CPLUSPLUS=y

#for polling driven uart
CONFIG_SERIAL=y

#for sha256
CONFIG_TINYCRYPT=y
CONFIG_TINYCRYPT_SHA256=y

#for randomness
CONFIG_ENTROPY_GENERATOR=y
CONFIG_TEST_RANDOM_GENERATOR=y

#for exceptions
CONFIG_EXCEPTIONS=y
CONFIG_NEWLIB_LIBC_NANO=n

#regarding memory
CONFIG_MAIN_STACK_SIZE=1536
```

## src/main.cpp
```c
//#include <iostream>
#include <iomanip>

#include <zephyr/kernel.h>

#include "tiny/include/math_utils.h"
#include "tiny/include/progressive_verification.h"
#include "tiny/include/standard_verification.h"
#include "tiny/include/rainbow.h"

#include "svk.h"


using Rainbow::gf;

unsigned char salt[Rainbow::SALT_SIZE];
unsigned char message_digest[Rainbow::SHA_DIGEST_SIZE];
unsigned char final_digest[Rainbow::FINAL_DIGEST_SIZE];

const unsigned char message[] = "Hello, my name is Slim Shady";

int main() {
    // declare variables
    uint32_t result_vector_time = 0, eff_verification_time = 0, effprog_verification_time = 0;
    
    Rainbow::get_message_digest(message, message_digest, strlen((const char*) message));

    // load the linear transformation and the short verification key as a Matrix objects
    MatrixDS<gf> SVK = MatrixDS<gf>((gf*) short_private_key, SVK_NROWS, Rainbow::N);
    MatrixDS<gf> C = MatrixDS<gf>((gf*) private_transformation, SVK_NROWS, Rainbow::n_polynomials);

    for (uint16_t i = 0; i < SAMPLE_SIZE; i++) {
        VectorDS<gf> s = Rainbow::parse_signature(salt);

        // Compute resulting vector
        Rainbow::get_complete_digest(final_digest, message_digest, salt);
        VectorDS<gf> u = Rainbow::get_result_vector(final_digest);

        // 1) Compute reduced resulting vector
        uint32_t starting_cycle = k_cycle_get_32();
        VectorDS<gf> u_eff = (VectorDS<gf>) (C * u);
        result_vector_time += k_cyc_to_us_floor32(k_cycle_get_32() - starting_cycle);

        // 2) Perform efficient verification
        starting_cycle = k_cycle_get_32();
        bool efficient_result = verify_signature(SVK, s, u_eff);
        eff_verification_time += k_cyc_to_us_floor32(k_cycle_get_32() - starting_cycle);

        // 3) Perform efficient+progressive verification
        starting_cycle = k_cycle_get_32();
        bool effprog_result = progVer(SVK, s, u_eff, PROGRESSIVE_STEPS);
        effprog_verification_time += k_cyc_to_us_floor32(k_cycle_get_32() - starting_cycle);

        //std::cout << (unsigned char) efficient_result << (unsigned char) effprog_result << std::endl;
    }

    printf("Average resulting vector time: %u microseconds\n", result_vector_time / SAMPLE_SIZE);
    printf("Average efficient verification time: %u microseconds\n", eff_verification_time / SAMPLE_SIZE);
    printf("Average efficient+progressive verification time: %u microseconds\n", effprog_verification_time / SAMPLE_SIZE);
    
    return 0;
}
```
