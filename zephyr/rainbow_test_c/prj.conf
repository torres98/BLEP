## CMakeLists.txt
```
# SPDX-License-Identifier: Apache-2.0

cmake_minimum_required(VERSION 3.20.0)

find_package(Zephyr REQUIRED HINTS $ENV{ZEPHYR_BASE})
project(rainbow_test)

if (${RAINBOW_VERSION} STREQUAL "1")
    set(GF "gf16")
elseif (${RAINBOW_VERSION} STREQUAL "2")
    set(GF "gf256")
    set(HASH_LIB "src/tiny/utils/SHA/sha384.c")
elseif (${RAINBOW_VERSION} STREQUAL "3")
    set(GF "gf256")
    set(HASH_LIB "src/tiny/utils/SHA/sha512.c")
else()
    MESSAGE(FATAL_ERROR "Rainbow version not recognized.")
endif()

add_definitions(-DRAINBOW_VERSION=${RAINBOW_VERSION})

add_definitions(-DELEM_TYPE=${GF})
add_definitions(-DELEM_ADD=${GF}_add)
add_definitions(-DELEM_SUB=${GF}_add)
add_definitions(-DELEM_MUL=${GF}_mul)

if(DEFINED ELEM_BIT_SIZE)
    add_definitions(-DELEM_BIT_SIZE=${ELEM_BIT_SIZE})
endif()

if (DEFINED GF16_LOOKUP)
    add_definitions(-DGF16_LOOKUP=${GF16_LOOKUP})
endif()

if (DEFINED GF256_LOOKUP)
    add_definitions(-DGF256_LOOKUP=${GF256_LOOKUP})
endif()

add_definitions(-include /home/torres/Desktop/Thesis/verification_implementation/zephyr/rainbow_test_c/src/tiny/include/${GF}.h)
#target_compile_definitions(app PRIVATE "-include /home/torres/Desktop/Thesis/verification_implementation/zephyr/rainbow_test_c/src/tiny/include/${GF}.h")


target_sources(app PRIVATE src/main.c src/tiny/schemes/rainbow.c src/tiny/utils/hash_utils.c src/tiny/utils/math_utils.c src/tiny/utils/memory_utils.c src/tiny/utils/random_utils.c src/tiny/utils/uart_utils.c src/tiny/utils/standard_verification.c src/tiny/utils/progressive_verification.c src/tiny/gf/gf_operations.c src/tiny/gf/gf16.c src/tiny/gf/${GF}.c ${HASH_LIB})
```

## prj.conf
```kconfig
#for malloc
CONFIG_NEWLIB_LIBC=y

#for polling-driven uart
CONFIG_SERIAL=y

#for sha256
CONFIG_TINYCRYPT=y
CONFIG_TINYCRYPT_SHA256=y

#for randomness
CONFIG_TEST_RANDOM_GENERATOR=y

#regarding memory
CONFIG_MAIN_STACK_SIZE=1536

# to skip pushing buttons each time...
CONFIG_USB_CDC_ACM=y
```

## src/main.c
```c
#include <stdio.h>

#include <zephyr/kernel.h>

#include "tiny/include/standard_verification.h"
#include "tiny/include/progressive_verification.h"
#include "tiny/include/rainbow.h"
#include "tiny/include/math_utils.h"
#include "tiny/include/uart_utils.h"

#include "svk.h"


unsigned char salt[SALT_SIZE];
unsigned char final_digest[FINAL_DIGEST_SIZE];

int main() {
    uint16_t PROGRESSIVE_STEPS = read_uint32(uart_dev);

    //read signature
    MatrixDS* s = parse_signature(uart_dev, salt);

    // read message length (4 bytes) 
    uint32_t mlen = read_uint32(uart_dev);

    // read message and compute its Rainbow digest
    get_complete_digest_from_device(uart_dev, final_digest, salt, mlen);

    for (unsigned int i = 0; i < FINAL_DIGEST_SIZE; i++)
        printf("%02x", (unsigned int) final_digest[i]);

    printf("\n");

    // load the linear transformation and the short verification key as a Matrix objects
    MatrixDS* SVK = CreateMatrixFromArray((gf*) short_private_key, SVK_NROWS, N, false);
    MatrixDS* C = CreateMatrixFromArray((gf*) private_transformation, SVK_NROWS, n_polynomials, false);

    // Compute reduced result vector
    MatrixDS* u_eff = dot_product(C, get_result_vector(final_digest));

    // Perform efficient verification
    if (verify_signature_with_result_vector(SVK, s, u_eff))
        printf("Success\n");
    else
        printf("Failure\n");

    // Perform efficient + progressive verification
    if (progVer_with_result_vector(SVK, s, u_eff, PROGRESSIVE_STEPS, false))
        printf("Success\n");
    else
        printf("Failure\n");
    
    destroy_matrix(s);
    destroy_matrix(SVK);
    destroy_matrix(C);
    destroy_matrix(u_eff);

    return 0;

}
```
